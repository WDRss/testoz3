/dts-v1/;
/plugin/;
/
{
  compatible = "allwinner,sun50i-h616";
  fragment@0 {
    target = <&spi1>;
    __overlay__ {
      status = "okay";
      cs-gpios = <&pio 7 9 0>, <&pio 2 10 0>;
      ili9486: ili9486@0 {
        compatible = "panel-mipi-dbi-spi";
        reg = <0>;
        spi-max-frequency = <32000000>;
        buswidth = <8>;
        regwidth = <8>;
        width = <480>;
        height = <320>;
        reset-gpios = <&pio 2 7 0>;
        dc-gpios = <&pio 2 14 0>;
        fps = <30>;
        bgr = <1>;
        rotate = <270>;
        debug = <3>;
      };
    };
  };
};
